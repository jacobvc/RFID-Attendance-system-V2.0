#include "RfidLcd.h"
#ifndef NO_DISPLAY

/*
 *
 * Display normalization  (for ST7735 vs SSD1306)
 *
 */

#include <Adafruit_GFX.h>  //https://github.com/adafruit/Adafruit-GFX-Library
#ifdef USING_ST7735
// ST7735
#include <Adafruit_ST7735.h>  //https://github.com/adafruit/Adafruit_ST7735

#define SCREEN_WIDTH 160   // LED display width, in pixels
#define SCREEN_HEIGHT 128  // LED display height, in pixels

#define RGB565(r, g, b) ((((r) / 8) << 11) | (((g) / 4) << 5) | ((b) / 8))

#define BLACK RGB565(0, 0, 0)
#define WHITE RGB565(255, 255, 255)
#define RED RGB565(255, 0, 0)
#define BLUE RGB565(0, 0, 255)
#define GREEN RGB565(0, 255, 0)
#define ORANGE RGB565(255, 165, 0)

#define CLEAR_DISPLAY display.fillScreen(BACKGROUND_COLOR)
#define UPDATE_DISPLAY  // No update needed
Adafruit_ST7735 display = Adafruit_ST7735(ST7735_CS_PIN, ST7735_DC_PIN, ST7735_RST_PIN);
#else
// SSD1306
#include <Wire.h>
#include <Adafruit_SSD1306.h>  //https://github.com/adafruit/Adafruit_SSD1306
// Declaration for SSD1306 display connected using software I2C pins are(22 SCL, 21 SDA)
#define SCREEN_WIDTH 128  // OLED display width, in pixels
#define SCREEN_HEIGHT 64  // OLED display height, in pixels
#define OLED_RESET 0      // Reset pin # (or -1 if sharing Arduino reset pin)

#define CLEAR_DISPLAY display.clearDisplay()
#define UPDATE_DISPLAY display.display()

Adafruit_SSD1306 display(SCREEN_WIDTH, SCREEN_HEIGHT, &Wire, OLED_RESET);
#endif

//************************* Biometric Icons *********************************
#define Wifi_start_width 54
#define Wifi_start_height 49
const uint8_t PROGMEM Wifi_start_bits[] = {
  0x00, 0x00, 0x00, 0x00, 0x00, 0x00, 0x00, 0x00, 0x00, 0x00, 0x00, 0x00,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 0x00
};
#define Wifi_connected_width 63
#define Wifi_connected_height 49
const uint8_t PROGMEM Wifi_connected_bits[] = {
  0x00, 0x00, 0x00, 0x00, 0x00, 0x00, 0x00, 0x00, 0x00, 0x00, 0x00, 0x00,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 0x00
};

#define TIME_WIDTH 128

void RfidLcdSetup(void)
{
  //-----------initialize display-------------
#ifdef USING_ST7735
  display.initR(INITR_BLACKTAB);  // Init ST7735S chip, black tab
  display.setRotation(1);
#else
  if (!display.begin(SSD1306_SWITCHCAPVCC, 0x3C)) {  // Address 0x3D for 128x64
    Serial.println(F("SSD1306 allocation failed"));
    for (;;)
      ;  // Don't proceed, loop forever
  }
#endif
  CLEAR_DISPLAY;
}

void RfidLcdTick(void)
{

}

// Time display
void LcdDisplayTime()
{
    time_t now = time(nullptr);
    struct tm *p_tm = localtime(&now);
    CLEAR_DISPLAY;
    display.setTextSize(1);            // Normal 2:2 pixel scale
    display.setTextColor(TEXT_COLOR);  // Draw normal text
    display.setCursor(6, 3);
    display.print(p_tm);
    //display.print("    ");
    //Serial.println(p_tm);
    display.setTextSize(4);            // Normal 2:2 pixel scale
    display.setTextColor(TEXT_COLOR);  // Draw normal text
    display.setCursor((SCREEN_WIDTH - TIME_WIDTH) / 2, 21);
    if ((p_tm->tm_hour) < 10) {
      display.print("0");
      display.print(p_tm->tm_hour);
    } else display.print(p_tm->tm_hour);
    display.print(":");
    if ((p_tm->tm_min) < 10) {
      display.print("0");
      display.println(p_tm->tm_min);
    } else display.println(p_tm->tm_min);
    //display.print(" ");
    UPDATE_DISPLAY;
}

// Wifi displays
void LcdDisplayConnecting(String ssid)
{
    CLEAR_DISPLAY;
    display.setTextSize(2);            // Normal 1:1 pixel scale
    display.setTextColor(TEXT_COLOR);  // Draw normal text
    display.setCursor(0, 0);           // Start at top-left corner
    display.print(F("Connecting to \n"));
    display.setCursor(0, 68);
    display.setTextSize(2);
    display.print(ssid);
    display.drawBitmap((SCREEN_WIDTH - Wifi_start_width) / 2, 14, Wifi_start_bits, Wifi_start_width, Wifi_start_height, TEXT_COLOR);
    UPDATE_DISPLAY;
}
void LcdDisplayConnected(IPAddress ip)
{
    CLEAR_DISPLAY;
    display.setTextSize(1);            // Normal 1:1 pixel scale
    display.setTextColor(TEXT_COLOR);  // Draw normal text
    display.setCursor(0, 0);           // Start at top-left corner
    display.print(F("Connected "));
    display.print(ip);
    display.drawBitmap((SCREEN_WIDTH - Wifi_connected_width) / 2, 15, Wifi_connected_bits, Wifi_connected_width, Wifi_connected_height, TEXT_COLOR);
    UPDATE_DISPLAY;
}

static void PrintUserName(String name)
{
  char tmpName[80];
  if (name.length() < sizeof(tmpName)) {
    strcpy(tmpName, name.c_str());
    const char *tzname = strtok(tmpName, ",");
    if (tzname) {
      display.print(tzname + strlen(tzname) + 1);
      display.print("\n ");
      display.print(tzname);
      return;
    }
  }
  display.print(name);
}

void LcdDisplayApMode(String ssid, IPAddress ip)
{
    CLEAR_DISPLAY;
    display.setTextSize(2);
    display.setTextColor(RED);  // Draw normal text
    display.setCursor(25, 3);           // Start at top-left corner
    display.print(F("NO WiFi\n"));
    display.setTextColor(TEXT_COLOR);  // Draw normal text
    display.print(F("\nConnect to AP\n "));
    display.setTextColor(BLUE);  // Draw ssid color text
    display.print(ssid);
    display.setTextColor(TEXT_COLOR);  // Draw normal text
    display.print(F("\nAnd Browse to\n "));
    display.setTextColor(BLUE);  // Draw ip color text
    display.print(ip);
    UPDATE_DISPLAY;
}

// RFID Displays
void LcdDisplayNotifyArrive(String user_name)
{
  CLEAR_DISPLAY;
  display.setTextSize(2);            // Normal 2:2 pixel scale
  display.setTextColor(GREEN);  // Draw normal text
  display.setCursor(15, 0);          // Start at top-left corner
  display.print(F("Arrive"));
  display.setTextColor(TEXT_COLOR);  // Draw normal text
  display.setCursor(0, 20);
  PrintUserName(user_name);
  UPDATE_DISPLAY;
}
void LcdDisplayNotifyDepart(String user_name)
{
  CLEAR_DISPLAY;
  display.setTextSize(2);            // Normal 2:2 pixel scale
  display.setTextColor(ORANGE);  // Draw normal text
  display.setCursor(10, 0);          // Start at top-left corner
  display.print(F("Depart"));
  display.setTextColor(TEXT_COLOR);  // Draw normal text
  display.setCursor(0, 20);
  PrintUserName(user_name);
  UPDATE_DISPLAY;
}

void LcdDisplayNotifyAvailable(String message)
{
  CLEAR_DISPLAY;
  display.setTextSize(2);            // Normal 2:2 pixel scale
  display.setTextColor(TEXT_COLOR);  // Draw normal text
  display.setCursor(5, 0);           // Start at top-left corner
  display.print(F("Free Card"));
  UPDATE_DISPLAY;
}

void LcdDisplayNotifySuccessful(String message)
{
  CLEAR_DISPLAY;
  display.setTextSize(2);            // Normal 2:2 pixel scale
  display.setTextColor(TEXT_COLOR);  // Draw normal text
  display.setCursor(5, 0);           // Start at top-left corner
  display.print(F("New Card"));
  UPDATE_DISPLAY;
}

void LcdDisplayNotifyError(String message)
{
  CLEAR_DISPLAY;
  display.setTextSize(2);            // Normal 2:2 pixel scale
  display.setTextColor(ST77XX_RED);  // Draw error text
  display.setCursor(5, 0);           // Start at top-left corner
  display.print(message);
  UPDATE_DISPLAY;
}

void LcdDisplayEndNotice() 
{
  CLEAR_DISPLAY;
}

#endif